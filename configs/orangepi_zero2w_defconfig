## configs/orangepi_zero2w_defconfig
```kconfig
CONFIG_ARM=y
CONFIG_ARCH_SUNXI=y
CONFIG_DEFAULT_DEVICE_TREE="sun50i-h618-orangepi-zero2w"
CONFIG_SPL=y
CONFIG_DRAM_SUN50I_H616_READ_CALIBRATION=y
CONFIG_DRAM_SUN50I_H616_UNKNOWN_FEATURE=y
CONFIG_DRAM_SUN50I_H616_BIT_DELAY_COMPENSATION=y
CONFIG_MMC0_CD_PIN="PF6"
CONFIG_AXP_DCDC3_VOLT=1100
CONFIG_SPL_I2C_SUPPORT=y
CONFIG_AXP313A_POWER=y
CONFIG_DRAM_SUN50I_H616_DX_ODT=0x07070707
CONFIG_DRAM_SUN50I_H616_DX_DRI=0x0e0e0e0e
CONFIG_DRAM_SUN50I_H616_CA_DRI=0x0e0e
CONFIG_DRAM_SUN50I_H616_ODT_EN=0xaaaaeeee
CONFIG_DRAM_SUN50I_H616_TPR6=0x44000000
CONFIG_DRAM_SUN50I_H616_TPR10=0x402f6663
CONFIG_DRAM_SUN50I_H616_TPR11=0x24242624
CONFIG_DRAM_SUN50I_H616_TPR12=0x0f0f100f
CONFIG_MACH_SUN50I_H616=y
CONFIG_SUNXI_DRAM_H616_LPDDR4=y
CONFIG_DRAM_CLK=792
CONFIG_USB1_VBUS_PIN="PC16"
CONFIG_R_I2C_ENABLE=y
CONFIG_SPL_SPI_SUNXI=y
# CONFIG_SYS_MALLOC_CLEAR_ON_INIT is not set
CONFIG_SPL_I2C=y
CONFIG_SPL_SYS_I2C_LEGACY=y
CONFIG_SYS_I2C_MVTWSI=y
CONFIG_SYS_I2C_SLAVE=0x7f
CONFIG_SYS_I2C_SPEED=400000
CONFIG_SPI_FLASH_ZBIT=y
CONFIG_PHY_MOTORCOMM=y
CONFIG_SUN8I_EMAC=y
CONFIG_AXP313_POWER=y
CONFIG_SPI=y
CONFIG_USB_EHCI_HCD=y
CONFIG_USB_OHCI_HCD=y
CONFIG_USB_MUSB_GADGET=y
CONFIG_API=y
#CONFIG_HAS_BOARD_SIZE_LIMIT=y
#CONFIG_BOARD_SIZE_LIMIT=16
#CONFIG_NAND_BOOT=y
#CONFIG_ONENAND_BOOT=y
CONFIG_QSPI_BOOT=y
CONFIG_SATA_BOOT=y
CONFIG_SD_BOOT=y
CONFIG_SD_BOOT_QSPI=y
CONFIG_SPI_BOOT=y
CONFIG_SAVE_PREV_BL_FDT_ADDR=y
CONFIG_SAVE_PREV_BL_INITRAMFS_START_ADDR=y
#CONFIG_CEDIT=y
#CONFIG_SPL_FS_EXT4=y
CONFIG_SPL_FS_FAT=y
#CONFIG_SPL_FS_FAT_DMA_ALIGN=y
#CONFIG_SPL_FS_LOAD_PAYLOAD_NAME="u-boot.itb"
CONFIG_SPL_FAT_WRITE=y
CONFIG_SYS_MMCSD_FS_BOOT=y
CONFIG_SYS_MMCSD_FS_BOOT_PARTITION=1
CONFIG_SPL_MMC_WRITE=y
CONFIG_PARTITIONS=y
CONFIG_SPL_PARTITIONS=y
CONFIG_DOS_PARTITION=y
CONFIG_SPL_DOS_PARTITION=y
CONFIG_ISO_PARTITION=y
CONFIG_SPL_ISO_PARTITION=y
CONFIG_EFI_PARTITION=y
CONFIG_EFI_PARTITION_ENTRIES_NUMBERS=56
CONFIG_EFI_PARTITION_ENTRIES_OFF=0
CONFIG_SPL_EFI_PARTITION=y
CONFIG_PARTITION_UUIDS=y
CONFIG_SPL_PARTITION_UUIDS=y
CONFIG_PARTITION_TYPE_GUID=y
CONFIG_SPL_PARTITION_TYPE_GUID=y
CONFIG_SUPPORT_OF_CONTROL=y
CONFIG_PYLIBFDT=y
CONFIG_DTOC=y
CONFIG_BINMAN=y
CONFIG_ENV_IS_IN_EXT4=y
CONFIG_ENV_SECT_SIZE_AUTO=y
CONFIG_PROT_TCP=y
CONFIG_PROT_TCP_SACK=y
CONFIG_IPV6=y
CONFIG_CMD_BOOTDEV=yc
CONFIG_CMD_BOOTZ=y
CONFIG_CMD_BOOTMENU=y
CONFIG_CMD_MEMINFO=y
CONFIG_CMD_RANDOM=y
CONFIG_CMD_GPT_RENAME=y
CONFIG_CMD_MBR=y
CONFIG_CMD_LSBLK=y
CONFIG_CMD_PART=y
#CONFIG_CMD_SATA=y
#SYS_SATA_MAX_DEVICE=1
CONFIG_CMD_USB=y
CONFIG_CMD_CAT=y
CONFIG_CMD_BLOCK_CACHE=y
CONFIG_CMD_CLS=y
CONFIG_CMD_INI=y
#CONFIG_CMD_DATE=y
CONFIG_CMD_TIME=y
CONFIG_CMD_GETTIME=y
CONFIG_CMD_UUID=y
CONFIG_CMD_EXT2=y
CONFIG_CMD_EXT4=y
CONFIG_CMD_EXT4_WRITE=y
CONFIG_CMD_FAT=y
CONFIG_CMD_FS_GENERIC=y
CONFIG_CMD_CYCLIC=y
CONFIG_CMD_DIAG=y
CONFIG_CMD_EVENT=y
CONFIG_CMD_WOL=y
#CONFIG_CMD_DHCP6=y
```
